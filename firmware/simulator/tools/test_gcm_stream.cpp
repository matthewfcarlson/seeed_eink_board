// Standalone verification for the streaming mbedtls_gcm_starts()/_update()/
// _finish() trio added to firmware/simulator/stubs/mbedtls/gcm.h - see root
// CLAUDE.md's "Encrypted Image Buckets" -> packed-blob compression plan.
//
// Deliberately does NOT try to fabricate its own "known-good" ciphertext by
// calling this decrypt-only stub in reverse (an earlier draft of this file
// did exactly that, treating a plaintext buffer as if it were ciphertext to
// produce a "reference" tag - it's wrong: the CTR keystream XOR is genuinely
// symmetric, so the byte output happens to be correct, but the GCM tag is
// NOT, since a real tag is always GHASH'd over the ciphertext, and that
// self-referential trick GHASHes over the pre-XOR plaintext instead. It's
// exactly the kind of self-consistent-but-wrong result this task warned
// about, and it was only caught by cross-checking against real Node output
// below - which is why that cross-check is the one that actually matters,
// not a substitute for it).
//
// So the only ground truth used here is real ciphertext generated by Node's
// actual `crypto.subtle` AES-256-GCM (gen_gcm_vectors.mjs writes key.bin,
// gvecN.plain.bin, gvecN.blob.bin = nonce(12)||ciphertext||tag(16)). For each
// vector, chunked streaming decrypt (mbedtls_gcm_starts/_update/_finish, fed
// several different chunk sizes - mimicking exactly how device_app.h's
// decryptChunksInflate() drives it) must recover the exact original
// plaintext AND compute the exact same 16-byte tag Node did; the existing
// one-shot mbedtls_gcm_auth_decrypt() in this same file (already verified
// against real WebCrypto per its own doc comment) is also cross-checked
// against the same real ciphertext, confirming the one-shot and streaming
// paths agree with each other on real external data, not just internally.
//
// Easiest: from firmware/simulator/, run `npm test` (or `make test`) - builds
// and runs this alongside the other two native pipeline tests, regenerating
// fixtures fresh each time. See README.md's "Native pipeline tests".
//
// To build/run just this one directly (from firmware/simulator/):
//   node tools/gen_gcm_vectors.mjs
//   clang++ -std=c++17 -I stubs tools/test_gcm_stream.cpp \
//     -framework Security -framework CoreFoundation -o tools/test_gcm_stream
//   tools/test_gcm_stream tools/gcm_vectors

#include <cstdio>
#include <cstdlib>
#include <cstring>
#include <string>
#include <vector>

#include "mbedtls/gcm.h"

static std::vector<uint8_t> readFile(const std::string& path, bool& ok) {
    FILE* f = fopen(path.c_str(), "rb");
    if (!f) {
        ok = false;
        return {};
    }
    fseek(f, 0, SEEK_END);
    long len = ftell(f);
    fseek(f, 0, SEEK_SET);
    std::vector<uint8_t> buf(len > 0 ? (size_t)len : 0);
    if (len > 0) {
        size_t n = fread(buf.data(), 1, (size_t)len, f);
        ok = n == (size_t)len;
    } else {
        ok = true;
    }
    fclose(f);
    return buf;
}

// Streams `ciphertext` through mbedtls_gcm_update() chunkSize bytes at a time
// (0 = all at once), keyed by `key`/`nonce`. Returns false on any internal
// error. Always fills `plaintextOut` (same size as ciphertext) and
// `computedTag`, regardless of whether the tag will later be found to match -
// tag comparison is the caller's job, matching real device_app.h usage.
static bool streamDecrypt(const uint8_t key[32], const uint8_t nonce[12], const std::vector<uint8_t>& ciphertext,
                           size_t chunkSize, std::vector<uint8_t>& plaintextOut, uint8_t computedTag[16]) {
    mbedtls_gcm_context ctx;
    mbedtls_gcm_init(&ctx);
    if (mbedtls_gcm_setkey(&ctx, MBEDTLS_CIPHER_ID_AES, key, 256) != 0) {
        mbedtls_gcm_free(&ctx);
        return false;
    }
    if (mbedtls_gcm_starts(&ctx, MBEDTLS_GCM_DECRYPT, nonce, 12, nullptr, 0) != 0) {
        mbedtls_gcm_free(&ctx);
        return false;
    }

    plaintextOut.assign(ciphertext.size(), 0);
    if (chunkSize == 0) chunkSize = ciphertext.size() > 0 ? ciphertext.size() : 1;

    size_t off = 0;
    while (off < ciphertext.size()) {
        size_t n = ciphertext.size() - off < chunkSize ? ciphertext.size() - off : chunkSize;
        if (mbedtls_gcm_update(&ctx, n, ciphertext.data() + off, plaintextOut.data() + off) != 0) {
            mbedtls_gcm_free(&ctx);
            return false;
        }
        off += n;
    }

    int rc = mbedtls_gcm_finish(&ctx, computedTag, 16);
    mbedtls_gcm_free(&ctx);
    return rc == 0;
}

static bool tagsEqual(const uint8_t a[16], const uint8_t b[16]) { return memcmp(a, b, 16) == 0; }

int main(int argc, char** argv) {
    int failures = 0;
    int testsRun = 0;
    const size_t chunkSizes[] = {0 /* one-shot */, 1, 3, 15, 16, 17, 64, 512, 65536};

    // ---- The only check: interoperate with real Node crypto.subtle AES-256-GCM output ----
    if (argc < 2) {
        fprintf(stderr, "usage: %s <gcm-vectors-dir>\n", argv[0]);
        return 2;
    }
    {
        std::string dir = argv[1];
        bool okKey = false;
        auto key = readFile(dir + "/key.bin", okKey);
        if (!okKey || key.size() != 32) {
            fprintf(stderr, "could not read a 32-byte key.bin from %s (run gen_gcm_vectors.mjs first)\n",
                    dir.c_str());
            failures++;
        } else {
            const int kNumVectors = 5;
            for (int i = 0; i < kNumVectors; i++) {
                bool ok1 = false, ok2 = false;
                auto plain = readFile(dir + "/gvec" + std::to_string(i) + ".plain.bin", ok1);
                auto blob = readFile(dir + "/gvec" + std::to_string(i) + ".blob.bin", ok2);
                if (!ok1 || !ok2) {
                    fprintf(stderr, "missing fixture files for vector %d\n", i);
                    failures++;
                    continue;
                }
                if (blob.size() < 28) {
                    fprintf(stderr, "vector %d blob too short (%zu)\n", i, blob.size());
                    failures++;
                    continue;
                }
                uint8_t nonce[12];
                memcpy(nonce, blob.data(), 12);
                std::vector<uint8_t> ciphertext(blob.begin() + 12, blob.end() - 16);
                uint8_t expectedTag[16];
                memcpy(expectedTag, blob.data() + blob.size() - 16, 16);

                printf("gvec %d: plain=%zu ciphertext=%zu\n", i, plain.size(), ciphertext.size());

                for (size_t chunkSize : chunkSizes) {
                    testsRun++;
                    std::vector<uint8_t> recovered;
                    uint8_t tag[16];
                    bool ok = streamDecrypt(key.data(), nonce, ciphertext, chunkSize, recovered, tag);
                    bool matches = ok && recovered == plain && tagsEqual(tag, expectedTag);
                    if (!matches) {
                        fprintf(stderr, "  FAIL: gvec=%d chunkSize=%zu ok=%d plainMatch=%d tagMatch=%d\n", i,
                                chunkSize, ok, ok && recovered == plain, ok && tagsEqual(tag, expectedTag));
                        failures++;
                    } else {
                        printf("  ok: chunkSize=%zu%s\n", chunkSize, chunkSize == 0 ? " (one-shot)" : "");
                    }
                }

                // Also sanity-check against THIS FILE's existing one-shot
                // mbedtls_gcm_auth_decrypt() for the same real ciphertext -
                // confirms the one-shot and streaming paths agree on real
                // external data too, not just on internally-generated data.
                mbedtls_gcm_context ctx;
                mbedtls_gcm_init(&ctx);
                mbedtls_gcm_setkey(&ctx, MBEDTLS_CIPHER_ID_AES, key.data(), 256);
                std::vector<uint8_t> oneShotOut(ciphertext.size());
                int rc = mbedtls_gcm_auth_decrypt(&ctx, ciphertext.size(), nonce, 12, nullptr, 0, expectedTag, 16,
                                                   ciphertext.data(), oneShotOut.data());
                mbedtls_gcm_free(&ctx);
                testsRun++;
                if (rc != 0 || oneShotOut != plain) {
                    fprintf(stderr, "  FAIL one-shot cross-check: gvec=%d rc=%d\n", i, rc);
                    failures++;
                } else {
                    printf("  ok: one-shot mbedtls_gcm_auth_decrypt() cross-check\n");
                }
            }
        }
    }

    printf("\n%d/%d checks passed\n", testsRun - failures, testsRun);
    if (failures > 0) {
        printf("%d FAILURES\n", failures);
        return 1;
    }
    printf("ALL PASSED\n");
    return 0;
}
